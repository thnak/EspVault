## main/Kconfig.projbuild
```kconfig
menu "EspVault Configuration"

    config VAULT_WIFI_SSID
        string "WiFi SSID"
        default "myssid"
        help
            SSID (network name) for the device to connect to.

    config VAULT_WIFI_PASSWORD
        string "WiFi Password"
        default "mypassword"
        help
            WiFi password (WPA or WPA2) for the device to use.

    config VAULT_MQTT_BROKER_URI
        string "MQTT Broker URI"
        default "mqtt://broker.example.com"
        help
            URI of the MQTT broker to connect to.
            Format: mqtt://hostname:port or mqtts://hostname:port for TLS

    config VAULT_MQTT_CLIENT_ID
        string "MQTT Client ID"
        default "esp32_vault_node"
        help
            Unique identifier for this MQTT client.

    config VAULT_MQTT_USERNAME
        string "MQTT Username"
        default ""
        help
            Username for MQTT authentication (leave empty if not required).

    config VAULT_MQTT_PASSWORD
        string "MQTT Password"
        default ""
        help
            Password for MQTT authentication (leave empty if not required).

    config VAULT_USE_TLS
        bool "Enable MQTT TLS/SSL"
        default n
        help
            Enable TLS/SSL encryption for MQTT connection.

    config VAULT_HEARTBEAT_INTERVAL_SEC
        int "Heartbeat Interval (seconds)"
        default 30
        range 10 3600
        help
            Interval in seconds between heartbeat messages to the broker.

    config VAULT_SEQ_SYNC_INTERVAL
        int "Sequence Counter Sync Interval"
        default 10
        range 1 1000
        help
            Number of events between NVS synchronization of sequence counter.

    config VAULT_HISTORY_SIZE_MB
        int "History Buffer Size (MB)"
        default 2
        range 1 4
        help
            Size of PSRAM history buffer in megabytes.

    config VAULT_NETWORK_QUEUE_SIZE_MB
        int "Network Queue Size (MB)"
        default 1
        range 1 4
        help
            Size of PSRAM network queue in megabytes.

    config VAULT_ENABLE_RMT
        bool "Enable RMT Peripheral"
        default n
        help
            Enable RMT peripheral for pulse width measurement.

    config VAULT_RMT_RX_GPIO
        int "RMT RX GPIO"
        depends on VAULT_ENABLE_RMT
        default 5
        range 0 39
        help
            GPIO pin for RMT receive (pulse width measurement).

    config VAULT_ENABLE_ESP_NOW
        bool "Enable ESP-NOW"
        default n
        help
            Enable ESP-NOW for local mesh networking.

endmenu
```

## sdkconfig.defaults
```kconfig
# ESP-IDF sdkconfig defaults for EspVault Universal Node
# These settings are optimized for dual-core ESP32 with 4MB PSRAM

# Partition Table
CONFIG_PARTITION_TABLE_CUSTOM=y
CONFIG_PARTITION_TABLE_CUSTOM_FILENAME="partitions.csv"
CONFIG_PARTITION_TABLE_FILENAME="partitions.csv"

# PSRAM Configuration (4MB minimum required)
CONFIG_SPIRAM=y
CONFIG_SPIRAM_SPEED_80M=y
CONFIG_SPIRAM_MODE_QUAD=y
CONFIG_SPIRAM_USE_MALLOC=y
CONFIG_SPIRAM_MALLOC_ALWAYSINTERNAL=16384
CONFIG_SPIRAM_MALLOC_RESERVE_INTERNAL=32768

# FreeRTOS - Dual Core Mode
CONFIG_FREERTOS_UNICORE=n
CONFIG_FREERTOS_HZ=1000
CONFIG_FREERTOS_WATCHPOINT_END_OF_STACK=y

# WiFi Configuration
CONFIG_ESP_WIFI_STATIC_RX_BUFFER_NUM=10
CONFIG_ESP_WIFI_DYNAMIC_RX_BUFFER_NUM=32
CONFIG_ESP_WIFI_DYNAMIC_TX_BUFFER_NUM=32
CONFIG_ESP_WIFI_AMPDU_TX_ENABLED=y
CONFIG_ESP_WIFI_AMPDU_RX_ENABLED=y

# MQTT Configuration
CONFIG_MQTT_PROTOCOL_5=y
CONFIG_MQTT_TRANSPORT_SSL=y
CONFIG_MQTT_TRANSPORT_WEBSOCKET=y

# Networking
CONFIG_LWIP_MAX_SOCKETS=16
CONFIG_LWIP_SO_REUSE=y
CONFIG_LWIP_SO_RCVBUF=y
CONFIG_LWIP_TCP_RECVMBOX_SIZE=32
CONFIG_LWIP_UDP_RECVMBOX_SIZE=32

# NVS Configuration
CONFIG_NVS_ENCRYPTION=y

# Logging
CONFIG_LOG_DEFAULT_LEVEL_INFO=y
CONFIG_LOG_MAXIMUM_LEVEL_VERBOSE=y

# Task Watchdog
CONFIG_ESP_TASK_WDT=y
CONFIG_ESP_TASK_WDT_PANIC=y
CONFIG_ESP_TASK_WDT_TIMEOUT_S=10

# Heap Memory
CONFIG_HEAP_POISONING_COMPREHENSIVE=y
CONFIG_HEAP_TRACING_STANDALONE=y

# Component Configuration
CONFIG_COMPILER_OPTIMIZATION_PERF=y
CONFIG_COMPILER_OPTIMIZATION_ASSERTIONS_ENABLE=y

# Security (for production, enable these)
# CONFIG_SECURE_BOOT_V2_ENABLED=y
# CONFIG_SECURE_FLASH_ENC_ENABLED=y
# CONFIG_SECURE_FLASH_ENCRYPTION_MODE_RELEASE=y

# ESP32-specific
CONFIG_ESP32_DEFAULT_CPU_FREQ_240=y
CONFIG_ESP32_SPIRAM_SUPPORT=y

# Bootloader
CONFIG_BOOTLOADER_LOG_LEVEL_INFO=y
CONFIG_BOOTLOADER_SKIP_VALIDATE_IN_DEEP_SLEEP=y

# Application Level Tracing
CONFIG_APPTRACE_ENABLE=n

# Power Management
CONFIG_PM_ENABLE=n
```

## test/qemu/sdkconfig.defaults
```kconfig
# QEMU Configuration for EspVault Tests

# Flash configuration
CONFIG_ESPTOOLPY_FLASHMODE_QIO=y
CONFIG_ESPTOOLPY_FLASHFREQ_40M=y
CONFIG_ESPTOOLPY_FLASHSIZE_4MB=y
CONFIG_ESPTOOLPY_FLASHSIZE="4MB"

# Partition table
CONFIG_PARTITION_TABLE_CUSTOM=y
CONFIG_PARTITION_TABLE_CUSTOM_FILENAME="partitions_qemu.csv"
CONFIG_PARTITION_TABLE_FILENAME="partitions_qemu.csv"

# Enable PSRAM (simulated in QEMU)
CONFIG_SPIRAM=y
CONFIG_SPIRAM_BOOT_INIT=y
CONFIG_SPIRAM_USE_MALLOC=y
CONFIG_SPIRAM_TYPE_AUTO=y
CONFIG_SPIRAM_SIZE=4194304

# FreeRTOS for dual-core testing
CONFIG_FREERTOS_UNICORE=n

# Logging
CONFIG_LOG_DEFAULT_LEVEL_DEBUG=y
CONFIG_LOG_DEFAULT_LEVEL=4

# MQTT
CONFIG_MQTT_PROTOCOL_5=y

# NVS
CONFIG_NVS_ENCRYPTION=n

# Unity test framework
CONFIG_UNITY_ENABLE_FLOAT=y
CONFIG_UNITY_ENABLE_DOUBLE=y
CONFIG_UNITY_ENABLE_BACKTRACE_ON_FAIL=y

# Reduce optimization for better debugging in QEMU
CONFIG_COMPILER_OPTIMIZATION_DEBUG=y
```
